## conf/layer.conf
```bitbake
# We have a conf and classes directory, add to BBPATH
BBPATH .= ":${LAYERDIR}"

# We have a recipes directory, add to BBFILES
BBFILES += "${LAYERDIR}/recipes-*/*/*.bb \
            ${LAYERDIR}/recipes-*/*/*.bbappend"

BBFILE_COLLECTIONS += "inf"
BBFILE_PATTERN_inf = "^${LAYERDIR}/"
BBFILE_PRIORITY_inf = "9"
LAYERSERIES_COMPAT_inf = "mickledore"

#LAYERDEPENDS_inf = "fsl-arm"

IMX_DEFAULT_BOOTLOADER:imx-nxp-bsp = "u-boot-influx"

# Avoid multiple runtime providers for u-boot-default-env
PREFERRED_RPROVIDER_u-boot-default-env ??= "${IMX_DEFAULT_BOOTLOADER}"
```

## conf/machine/imx8mm-smart.conf
```bitbake
#@TYPE: Machine
#@NAME: Influx Technology i.MX8MM rexgen smart
#@SOC: i.MX8MQ
#@DESCRIPTION: Machine configuration for Influx Technology i.MX8MM rexgen smart
#@MAINTAINER: EA <imx@embeddedartists.com>

MACHINEOVERRIDES =. "mx8:mx8m:mx8mm:"


require conf/machine/include/imx-base.inc
require conf/machine/include/arm/armv8a/tune-cortexa53.inc

UBOOT_PROVIDES_BOOT_CONTAINER = "0"
UBOOT_PROVIDES_BOOT_CONTAINER:mx8m-generic-bsp = "0"

PREFERRED_PROVIDER_virtual/kernel:imx-nxp-bsp = "linux-inf"
PREFERRED_PROVIDER_virtual/kernel = "linux-inf"
PREFERRED_RPROVIDER_kernel-module-imx-gpu-viv = "linux-inf"

PREFERRED_PROVIDER_u-boot = "u-boot-inf"
PREFERRED_PROVIDER_virtual/bootloader:imx-nxp-bsp = "u-boot-inf"
PREFERRED_PROVIDER_u-boot-mfgtool = "u-boot-inf-mfgtool"
PREFERRED_PROVIDER_u-boot-fw-utils = "u-boot-inf-fw-utils"

MACHINE_FEATURES += " pci nxp8987 mrvl8997"

KERNEL_DEVICETREE = "influx/imx8mm-influx-rex-smart_v2-1mw.dtb \
                     influx/imx8mm-influx-rex-smart_v2.dtb \                    
                     influx/imx8mm-influx-rex-smart_v2-m4.dtb \                     
"

IMAGE_BOOTFILES_DEPENDS += "imx-m4-demos:do_deploy"
IMAGE_BOOTFILES += "imx8mm_m4_TCM_hello_world.bin \
			imx8mm_m4_TCM_rpmsg_lite_pingpong_rtos_linux_remote.bin \
			imx8mm_m4_TCM_rpmsg_lite_str_echo_rtos.bin \
"

UBOOT_CONFIG ??= "sd"
UBOOT_CONFIG[sd] = "mx8mm-smart_config,sdcard"
UBOOT_CONFIG[mfgtool] = "mx8mm-smart_config"
SPL_BINARY = "spl/u-boot-spl.bin"

ATF_PLATFORM = "imx8mm"

# Set DDR FIRMWARE
DDR_FIRMWARE_NAME = "lpddr4_pmu_train_1d_imem.bin lpddr4_pmu_train_1d_dmem.bin lpddr4_pmu_train_2d_imem.bin lpddr4_pmu_train_2d_dmem.bin"

# Set u-boot DTB
UBOOT_DTB_NAME = "imx8mm-influx-rex-smart_v2.dtb"

# Set imx-mkimage boot target
IMXBOOT_TARGETS = "flash_evk"

IMX_BOOT_SOC_TARGET = "iMX8MM"

# Set Serial console
SERIAL_CONSOLES = "115200;ttymxc3"

IMAGE_BOOTLOADER = "imx-boot"

BOOT_SPACE = "65536"

LOADADDR = ""
UBOOT_SUFFIX = "bin"
UBOOT_MAKE_TARGET = ""
IMX_BOOT_SEEK = "33"

# wic support
IMAGE_BOOT_FILES:append = " \
        boot.scr \
"
WKS_FILE_DEPENDS += " \
        u-boot-script-inf \
        e2fsprogs-native \
        bmap-tools-native \
"
```

## conf/machine/imx8mn-influx-rex-smart.conf
```bitbake
#@TYPE: Machine
#@NAME: Embedded Artists i.MX8M Nano uCOM Board
#@SOC: i.MX8MN
#@DESCRIPTION: Machine configuration for Embedded Artists i.MX8M Nano uCOM Board
#@MAINTAINER: EA <imx@embeddedartists.com>

MACHINEOVERRIDES =. "mx8:mx8m:mx8mn:"

require conf/machine/include/imx-base.inc
require conf/machine/include/arm/armv8a/tune-cortexa53.inc

UBOOT_PROVIDES_BOOT_CONTAINER = "0"
UBOOT_PROVIDES_BOOT_CONTAINER:mx8m-generic-bsp = "0"

PREFERRED_PROVIDER_virtual/kernel:imx-nxp-bsp = "linux-inf"
PREFERRED_PROVIDER_virtual/kernel = "linux-inf"
PREFERRED_RPROVIDER_kernel-module-imx-gpu-viv = "linux-inf"

PREFERRED_PROVIDER_u-boot = "u-boot-inf"
PREFERRED_PROVIDER_virtual/bootloader:imx-nxp-bsp = "u-boot-inf"
PREFERRED_PROVIDER_u-boot-mfgtool = "u-boot-inf-mfgtool"
PREFERRED_PROVIDER_u-boot-fw-utils = "u-boot-inf-fw-utils"

MACHINE_FEATURES += " pci nxp8987 mrvl8997"

KERNEL_DEVICETREE = "freescale/imx8mn-influx-rex-smart_v2.dtb \
                     freescale/imx8mn-influx-rex-smart_v2-1mw.dtb \
                     freescale/imx8mn-influx-rex-smart_v2-2inf.dtb \
                     freescale/imx8mn-influx-rex-smart_v2-m4.dtb \
                     freescale/imx8mn-influx-rex-smart_v2-usb-host.dtb \
                     freescale/imx8mn-influx-rex-smart_v2-ov5640.dtb \
                     freescale/imx8mn-influx-rex-smart_v3.dtb \
                     freescale/imx8mn-influx-rex-smart_v3-1mw.dtb \
                     freescale/imx8mn-influx-rex-smart_v3-2inf.dtb \
                     freescale/imx8mn-influx-rex-smart_v3-m4.dtb \
                     freescale/imx8mn-influx-rex-smart_v3-ov5640.dtb \
"

IMAGE_BOOTFILES_DEPENDS += "imx-m7-demos:do_deploy"
IMAGE_BOOTFILES += "imx8mn_m7_TCM_hello_world.bin \
                    imx8mn_m7_TCM_rpmsg_lite_pingpong_rtos_linux_remote.bin \
                    imx8mn_m7_TCM_rpmsg_lite_str_echo_rtos.bin \
                    imx8mn_m7_TCM_sai_low_power_audio.bin \
"

UBOOT_CONFIG ??= "sd"
UBOOT_CONFIG[sd] = "mx8mn-influx-rex-smart_config,sdcard"
UBOOT_CONFIG[mfgtool] = "mx8mn-influx-rex-smart_config"
SPL_BINARY = "spl/u-boot-spl.bin"

ATF_PLATFORM = "imx8mn"

# Set DDR FIRMWARE
DDR_FIRMWARE_NAME = "ddr4_imem_1d_201810.bin ddr4_dmem_1d_201810.bin ddr4_imem_2d_201810.bin ddr4_dmem_2d_201810.bin"

# Set u-boot DTB
UBOOT_DTB_NAME = "imx8mn-influx-rex-smart_v2.dtb"

# Set imx-mkimage boot target
IMXBOOT_TARGETS = "flash_ddr4_evk"

IMX_BOOT_SOC_TARGET = "iMX8MN"

# Set Serial console
SERIAL_CONSOLES = "115200;ttymxc1"

IMAGE_BOOTLOADER = "imx-boot"

BOOT_SPACE = "65536"

LOADADDR = ""
UBOOT_SUFFIX = "bin"
UBOOT_MAKE_TARGET = ""
IMX_BOOT_SEEK = "33"

# wic support
IMAGE_BOOT_FILES:append = " \
        boot.scr \
"
WKS_FILE_DEPENDS += " \
        u-boot-script-inf \
        e2fsprogs-native \
        bmap-tools-native \
"
```

## recipes-influx/conf/layer.conf
```bitbake
# We have a conf and classes directory, add to BBPATH
BBPATH .= ":${LAYERDIR}"

# We have recipes-* directories, add to BBFILES
BBFILES += "${LAYERDIR}/recipes-*/*/*.bb \
            ${LAYERDIR}/recipes-*/*/*.bbappend"

BBFILE_COLLECTIONS += "../sources/meta-influx"
BBFILE_PATTERN_../sources/meta-influx = "^${LAYERDIR}/"
BBFILE_PRIORITY_../sources/meta-influx = "6"
```
